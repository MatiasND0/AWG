## ESP_code/main/Kconfig.projbuild
```kconfig
# put here your custom config value
menu "Example Configuration"
config ESP_WIFI_SSID
    string "WiFi SSID"
    default "myssid"
    help
	SSID (network name) for the example to connect to.

config ESP_WIFI_PASSWORD
    string "WiFi Password"
    default "mypassword"
    help
	WiFi password (WPA or WPA2) for the example to use.

choice EXAMPLE_DAC_CONTINUOUS_MODE
    prompt "Select DAC continuous example mode"
    default EXAMPLE_DAC_CONTINUOUS_BY_DMA
    help
        DAC output continuous data by DMA or timer

    config EXAMPLE_DAC_CONTINUOUS_BY_DMA
        bool "By DMA"
    config EXAMPLE_DAC_CONTINUOUS_BY_TIMER
        bool "By Timer"
endchoice

config EXAMPLE_WAVE_PERIOD_SEC
    int "Period of switching the waveform (Unit: Sec)"
    default 2
    help
        The waveforms will switch every several seconds,
        this configuration is to specify the switching period
endmenu

menu "I2C Slave"
    config I2C_SLAVE_SCL
        int "SCL GPIO Num"
        default 5
        help
            GPIO number for I2C Slave clock line.

    config I2C_SLAVE_SDA
        int "SDA GPIO Num"
        default 4
        help
            GPIO number for I2C Slave data line.

    config I2C_SLAVE_PORT_NUM
        int "Port Number"
        default 0
        help
            Port number for I2C Slave device.

    config I2C_SLAVE_ADDRESS
        hex "ESP Slave Address"
        default 0x28
        help
            Hardware Address of I2C Slave Port.
endmenu
```
